## Config.in
```kconfig
menu "Zebrafish"

source "$BR2_EXTERNAL_ZEBRAFISH_PATH/package/dnsoverhttps/Config.in"
source "$BR2_EXTERNAL_ZEBRAFISH_PATH/package/nghttp3/Config.in"
source "$BR2_EXTERNAL_ZEBRAFISH_PATH/package/ngtcp2/Config.in"
source "$BR2_EXTERNAL_ZEBRAFISH_PATH/package/crony/Config.in"
source "$BR2_EXTERNAL_ZEBRAFISH_PATH/package/knockrs/Config.in"
source "$BR2_EXTERNAL_ZEBRAFISH_PATH/package/nodeexporter/Config.in"
source "$BR2_EXTERNAL_ZEBRAFISH_PATH/package/zfsexporter/Config.in"
source "$BR2_EXTERNAL_ZEBRAFISH_PATH/package/ugrep/Config.in"
source "$BR2_EXTERNAL_ZEBRAFISH_PATH/package/bfs/Config.in"

menu "doas"
	source "$BR2_EXTERNAL_ZEBRAFISH_PATH/package/opendoas/Config.in"
endmenu

menu "dive"
	source "$BR2_EXTERNAL_ZEBRAFISH_PATH/package/dive/Config.in"
endmenu

menu "zfs"
	source "$BR2_EXTERNAL_ZEBRAFISH_PATH/package/userlandzfs/Config.in"
	source "$BR2_EXTERNAL_ZEBRAFISH_PATH/package/zrepl/Config.in"
endmenu

menu "iomemory-vsl4"
	source "$BR2_EXTERNAL_ZEBRAFISH_PATH/package/iomemory-vsl4/Config.in"
endmenu

endmenu
```

## buildroot-packages/crony/Config.in
```kconfig
config BR2_PACKAGE_CRONY
	bool "crony"
	depends on BR2_PACKAGE_HOST_RUSTC_TARGET_ARCH_SUPPORTS
	select BR2_PACKAGE_HOST_RUSTC
	help
      Crony is a replacement tool for the famous cron as well as crontab.

	  https://github.com/ClementNerma/Crony
```

## buildroot-packages/dropbear/Config.in
```kconfig
config BR2_PACKAGE_DROPBEAR
	bool "dropbear"
	select BR2_PACKAGE_ZLIB
	select BR2_PACKAGE_LIBTOMCRYPT
	help
	  A small SSH 2 server designed for small memory environments.

	  Note that dropbear requires a per-device unique host key. The
	  key will be generated when dropbear starts, but it is not
	  persistent over reboot (if you have a read-only rootfs) or
	  upgrade (if you have a read-write rootfs). To make the key
	  persistent, replace /etc/dropbear with a symlink to a
	  directory on a persistent, writeable filesystem.
	  Alternatively, mount a persistent unionfs over your root
	  filesystem.

	  https://matt.ucc.asn.au/dropbear/dropbear.html

if BR2_PACKAGE_DROPBEAR

config BR2_PACKAGE_DROPBEAR_LOCALOPTIONS_FILE
	string "path to custom localoptions.h definitions file"
	help
	  Path to a file whose contents will be appended to Dropbear
	  localoptions.h. It can be used to tweak the Dropbear
	  configuration.

endif
```

## buildroot-packages/nghttp2/Config.in
```kconfig
config BR2_PACKAGE_NGHTTP2
	bool "nghttp2"
	depends on BR2_PACKAGE_WOLFSSL
	depends on BR2_PACKAGE_NGHTTP3
	help
	  nghttp2 is an implementation of HTTP/2.

	  https://github.com/nghttp2/nghttp2/
```

## buildroot-packages/ripgrep/Config.in
```kconfig
config BR2_PACKAGE_RIPGREP
	bool "ripgrep"
	depends on BR2_PACKAGE_HOST_RUSTC_TARGET_ARCH_SUPPORTS
	select BR2_PACKAGE_HOST_RUSTC
	help
	  ripgrep is a line-oriented search tool that
	  recursively searches your current directory
	  for a regex pattern while respecting your gitignore
	  rules.

	  ripgrep is similar to other popular search tools like
	  The Silver Searcher, ack and grep.

	  https://github.com/BurntSushi/ripgrep

if BR2_PACKAGE_RIPGREP

config BR2_PACKAGE_RIPGREP_PCRE2
	bool "enable PCRE2 regex engine"
	select BR2_PACKAGE_PCRE2
	help
	  Enable ripgrep optional PCRE2-based regex engine
	  (equivalent to cargo feature: pcre2).

endif
```

## buildroot-packages/strace/Config.in
```kconfig
config BR2_PACKAGE_STRACE
	bool "strace"
	help
	  A useful diagnostic, instructional, and debugging tool.
	  Allows you to track what system calls a program makes
	  while it is running.

	  If you want 'strace -k' to work, make sure to enable the
	  'libunwind' package.

	  https://strace.io
```

## buildroot-packages/unbound/Config.in
```kconfig
config BR2_PACKAGE_UNBOUND
	bool "unbound"
	depends on !BR2_STATIC_LIBS
	select BR2_PACKAGE_EXPAT
	select BR2_PACKAGE_LIBEVENT
	select BR2_PACKAGE_OPENSSL
	select BR2_PACKAGE_NGHTTP2
	help
	  Unbound is a validating, recursive, and caching DNS resolver.
	  It supports DNSSEC, QNAME minimisation, DNS-over-TLS and
	  DNSCrypt.

	  https://www.unbound.net

comment "unbound needs a toolchain w/ dynamic library"
	depends on BR2_STATIC_LIBS
```

## configs/zebrafish_x64_defconfig
```kconfig
BR2_x86_64=y
BR2_ARCH_HAS_TOOLCHAIN_BUILDROOT=y
BR2_ARCH="x86_64"
BR2_NORMALIZED_ARCH="x86_64"
BR2_ENDIAN="LITTLE"
BR2_GCC_TARGET_ARCH="x86-64"
BR2_BINFMT_SUPPORTS_SHARED=y
BR2_READELF_ARCH_NAME="Advanced Micro Devices X86-64"
BR2_X86_CPU_HAS_MMX=y
BR2_X86_CPU_HAS_SSE=y
BR2_X86_CPU_HAS_SSE2=y
BR2_X86_CPU_HAS_SSE3=y
BR2_X86_CPU_HAS_SSSE3=y
BR2_X86_CPU_HAS_SSE4=y
BR2_X86_CPU_HAS_SSE42=y
BR2_X86_CPU_HAS_AVX=y
BR2_X86_CPU_HAS_AVX2=y
BR2_x86_x86_64=y
BR2_LINUX_KERNEL_CUSTOM_CONFIG_FILE="$(BR2_EXTERNAL_ZEBRAFISH_PATH)/board/pc/linux_x64.config"

BR2_PACKAGE_HOST_LINUX_HEADERS_CUSTOM_6_11=y

BR2_PACKAGE_GLIBC_UTILS=y
BR2_TOOLCHAIN_GLIBC_GCONV_LIBS_COPY=y
BR2_TOOLCHAIN_BUILDROOT_CXX=y
BR2_OPTIMIZE_FAST=y
BR2_GLOBAL_PATCH_DIR="$(BR2_EXTERNAL_ZEBRAFISH_PATH)/patches"
BR2_RELRO_FULL=y
BR2_FORTIFY_SOURCE_3=y
BR2_SSP_STRONG=y
BR2_ENABLE_DEBUG=n
BR2_TARGET_GENERIC_HOSTNAME="zebrafish"
BR2_TARGET_GENERIC_ISSUE="Welcome to Zebrafish!"
BR2_TARGET_GENERIC_PASSWD_SHA512=y
BR2_ROOTFS_DEVICE_CREATION_DYNAMIC_EUDEV=y
BR2_ROOTFS_DEVICE_TABLE="system/device_table.txt system/device_table_dev.txt $(BR2_EXTERNAL_ZEBRAFISH_PATH)/device-table.txt"
BR2_ROOTFS_DEVICE_TABLE_SUPPORTS_EXTENDED_ATTRIBUTES=y
BR2_ENABLE_LOCALE_WHITELIST="C C.UTF-8 en_US en_US.UTF-8"
BR2_GENERATE_LOCALE="C en_US"
BR2_TARGET_TZ_INFO=y
BR2_TARGET_LOCALTIME="Europe/Bucharest"
BR2_ROOTFS_USERS_TABLES="$(BR2_EXTERNAL_ZEBRAFISH_PATH)/users.txt"
BR2_ROOTFS_OVERLAY="$(BR2_EXTERNAL_ZEBRAFISH_PATH)/rootfs-overlay"
BR2_ROOTFS_POST_BUILD_SCRIPT="$(BR2_EXTERNAL_ZEBRAFISH_PATH)/board/pc/post-build.sh"
BR2_ROOTFS_POST_FAKEROOT_SCRIPT="$(BR2_EXTERNAL_ZEBRAFISH_PATH)/post-fakeroot.sh"
BR2_ROOTFS_POST_IMAGE_SCRIPT="$(BR2_EXTERNAL_ZEBRAFISH_PATH)/board/pc/post-image.sh"
BR2_LINUX_KERNEL=y
BR2_LINUX_KERNEL_USE_CUSTOM_CONFIG=y
BR2_LINUX_KERNEL_CUSTOM_TARBALL=y
BR2_LINUX_KERNEL_CUSTOM_TARBALL_LOCATION="https://deb.tohka.us/kernel/stable/zfs.tar.xz"
BR2_LINUX_KERNEL_VERSION="custom"
BR2_LINUX_KERNEL_ZSTD=y
BR2_LINUX_KERNEL_NEEDS_HOST_OPENSSL=y
BR2_LINUX_KERNEL_NEEDS_HOST_LIBELF=y
BR2_PACKAGE_LINUX_TOOLS_CPUPOWER=y
BR2_PACKAGE_BUSYBOX_CONFIG="$(BR2_EXTERNAL_ZEBRAFISH_PATH)/board/pc/busybox.config"
BR2_PACKAGE_BUSYBOX_SHOW_OTHERS=y
BR2_PACKAGE_ZSTD=y
BR2_PACKAGE_ACPID=y
BR2_PACKAGE_EUDEV_RULES_GEN=y
BR2_PACKAGE_HDPARM=y
BR2_PACKAGE_PARTED=y
BR2_PACKAGE_USBUTILS=y
BR2_PACKAGE_CA_CERTIFICATES=y
BR2_PACKAGE_JITTERENTROPY_LIBRARY=y
BR2_PACKAGE_LIBCURL=y
BR2_PACKAGE_LIBCURL_CURL=y
BR2_PACKAGE_LIBCURL_WOLFSSL=y
BR2_PACKAGE_LIBCURL_OPENSSL=n
BR2_PACKAGE_LIBCAP=y
BR2_PACKAGE_NCURSES=y
BR2_PACKAGE_ETHTOOL=y
BR2_PACKAGE_IFTOP=y
# For rsync
BR2_PACKAGE_LIBNL=y
# BR2_PACKAGE_OPENSSH_SANDBOX is not set
BR2_PACKAGE_RSYNC=y
# BR2_PACKAGE_URANDOM_SCRIPTS is not set
BR2_PACKAGE_BASH=y
BR2_PACKAGE_INOTIFY_TOOLS=y
BR2_PACKAGE_TINI=y
BR2_PACKAGE_TMUX=y
BR2_PACKAGE_GETENT=y
BR2_PACKAGE_KMOD_TOOLS=y
BR2_PACKAGE_NANO=y
BR2_PACKAGE_NCDU=y
BR2_PACKAGE_HTOP=y
BR2_TARGET_ROOTFS_CPIO=y
BR2_TARGET_ROOTFS_CPIO_FULL=n
BR2_TARGET_ROOTFS_CPIO_NONE=n
BR2_TARGET_ROOTFS_CPIO_ZSTD=n
BR2_TARGET_ROOTFS_TAR=n
BR2_TARGET_ROOTFS_EROFS=n
BR2_PACKAGE_OPENDOAS=y
BR2_PACKAGE_FILE=n
BR2_PACKAGE_USERLANDZFS=y
BR2_PACKAGE_EFIBOOTMGR=y
BR2_PACKAGE_EFIVAR=y
BR2_PACKAGE_MBUFFER=y
BR2_PACKAGE_SOCAT=y
BR2_PACKAGE_PV=y
BR2_PACKAGE_ZREPL=y
BR2_PACKAGE_CONTAINERD=y
BR2_PACKAGE_NERDCTL=y
BR2_PACKAGE_MOBY_BUILDKIT=y
BR2_PACKAGE_CNI_PLUGINS=y
BR2_PACKAGE_CRUN=y
BR2_PACKAGE_RUNC=n
BR2_PACKAGE_YAJL=y
BR2_PACKAGE_IPTABLES=y
BR2_PACKAGE_IPTABLES_NFTABLES=y
BR2_PACKAGE_NFTABLES=y
BR2_PACKAGE_LIBSECCOMP=y
BR2_TARGET_GENERIC_GETTY=n
BR2_PACKAGE_COREUTILS=y

BR2_PACKAGE_SED=y
BR2_PACKAGE_PATCH=y
BR2_PACKAGE_GZIP=y
BR2_PACKAGE_LIBARCHIVE=y
BR2_PACKAGE_LIBARCHIVE_BSDTAR=y
BR2_PACKAGE_LIBARCHIVE_BSDCPIO=y
BR2_PACKAGE_LIBARCHIVE_BSDCAT=y
BR2_PACKAGE_ACL=y
BR2_PACKAGE_ATTR=y
BR2_PACKAGE_XZ=y
BR2_PACKAGE_ZLIB=y
BR2_PACKAGE_ZLIB_NG=y

BR2_PACKAGE_JQ=y
BR2_PACKAGE_GREP=y
BR2_PACKAGE_UGREP=n
BR2_PACKAGE_PCRE2=y
BR2_PACKAGE_FINDUTILS=y
BR2_PACKAGE_PROCPS_NG=y
BR2_PACKAGE_STRACE=y
BR2_PACKAGE_LTRACE=y

BR2_PACKAGE_NBD=y
BR2_PACKAGE_NBD_CLIENT=y
BR2_PACKAGE_NBD_SERVER=y
BR2_PACKAGE_NBD_TRDUMP=y
BR2_PACKAGE_WIREGUARD_TOOLS=y

BR2_PACKAGE_BIND=y
BR2_PACKAGE_BIND_TOOLS=y

BR2_PACKAGE_NGHTTP2=y
BR2_PACKAGE_NGHTTP3=y
BR2_PACKAGE_NGTCP2=y
BR2_PACKAGE_WOLFSSL=y
BR2_PACKAGE_WOLFSSL_ALL=y
BR2_PACKAGE_UNBOUND=y

BR2_PACKAGE_LIBUNISTRING=y
BR2_PACKAGE_LIBIDN2=y
BR2_PACKAGE_LIBPSL=y

BR2_PACKAGE_GIT=y
BR2_PACKAGE_OPENSSL=y
BR2_PACKAGE_LIBOPENSSL_BIN=y
BR2_PACKAGE_LIBOPENSSL_ENGINES=y

BR2_PACKAGE_DROPBEAR=y
BR2_PACKAGE_LIBTOMCRYPT=y

BR2_PACKAGE_IPERF3=y
BR2_PACKAGE_NLOAD=y
BR2_PACKAGE_LSHW=y

BR2_PACKAGE_GPTFDISK=y
BR2_PACKAGE_GPTFDISK_GDISK=y
BR2_PACKAGE_GPTFDISK_SGDISK=y
BR2_PACKAGE_GPTFDISK_CGDISK=y

BR2_PACKAGE_CRONY=y
BR2_PACKAGE_KNOCKRS=y
BR2_PACKAGE_NODEEXPORTER=n
BR2_PACKAGE_ZFSEXPORTER=n

BR2_PACKAGE_POWERTOP=y
BR2_PACKAGE_PCIUTILS=y
BR2_PACKAGE_LIBTRACEFS=y

BR2_PACKAGE_NVME=y
BR2_PACKAGE_UTIL_LINUX_LIBUUID=y

BR2_PACKAGE_HOST_GO=y

BR2_USE_WCHAR=y
BR2_PACKAGE_NCURSES_WCHAR=y

BR2_PACKAGE_NFS_UTILS=y
BR2_PACKAGE_NFS_UTILS_NFSV4=y
BR2_PACKAGE_NFS_UTILS_GSS=n
BR2_PACKAGE_NFS_UTILS_RPCDEBUG=y
BR2_PACKAGE_NFS_UTILS_RPC_LOCKD=y
BR2_PACKAGE_NFS_UTILS_RPC_NFSD=y
BR2_PACKAGE_NFS_UTILS_RPC_RQUOTAD=n

BR2_PACKAGE_CIFS_UTILS=y

BR2_PACKAGE_DIVE=y

BR2_PACKAGE_GESFTPSERVER=y

BR2_PACKAGE_DOCKER_CLI=y
BR2_PACKAGE_DOCKER_COMPOSE=y
BR2_PACKAGE_DOCKER_CLI_BUILDX=y
BR2_PACKAGE_DOCKER_ENGINE=y
BR2_PACKAGE_DOCKER_ENGINE_DOCKER_INIT_TINI=y
```

## package/bfs/Config.in
```kconfig
config BR2_PACKAGE_BFS
	bool "bfs"
	help
	  bfs is a breadth-first variant of the UNIX find command.

	  Optional support for acl, libcap, libselinux, liburing and
	  oniguruma is enabled automatically when those packages are
	  selected globally.

	  https://github.com/tavianator/bfs
```

## package/dive/Config.in
```kconfig
config BR2_PACKAGE_DIVE
	bool "dive"
	help
	  Explore Docker

	  https://github.com/wagoodman/dive/
```

## package/dnsoverhttps/Config.in
```kconfig
config BR2_PACKAGE_DNSOVERHTTPS
	bool "dnsoverhttps"
	select BR2_PACKAGE_LIBCURL
	select BR2_PACKAGE_C_ARES
	select BR2_PACKAGE_LIBEV
	help
		https://github.com/aarond10/https_dns_proxy
```

## package/iomemory-vsl4/Config.in
```kconfig
comment "iomemory-vsl4 needs a Linux kernel and is only available on x86_64"
	depends on !BR2_LINUX_KERNEL || !BR2_x86_64

config BR2_PACKAGE_IOMEMORY_VSL4
	bool "iomemory-vsl4"
	depends on BR2_LINUX_KERNEL
	depends on BR2_x86_64
	select BR2_LINUX_NEEDS_MODULES
	select BR2_PACKAGE_KMOD
	help
	  SanDisk/Fusion-io iomemory-vsl4 driver and utilities for
	  ioMemory PCIe flash storage devices.

	  This package provides:
	  - The iomemory-vsl4 kernel module (built-in)
	  - Firmware files for Fusion-io devices
	  - fio-util command-line utilities

	  Note: This package is only available on x86_64 architecture.

	  https://github.com/RemixVSL/iomemory-vsl4

if BR2_PACKAGE_IOMEMORY_VSL4

config BR2_PACKAGE_IOMEMORY_VSL4_FIRMWARE
	bool "Install firmware files"
	default y
	help
	  Install Fusion-io firmware files to /lib/firmware/fio.

config BR2_PACKAGE_IOMEMORY_VSL4_UTILS
	bool "Install fio-util utilities"
	default y
	help
	  Install fio-util command-line utilities including:
	  fio-attach, fio-beacon, fio-bugreport, fio-control,
	  fio-detach, fio-format, fio-status, and more.

endif
```

## package/knockrs/Config.in
```kconfig
config BR2_PACKAGE_KNOCKRS
	bool "knockrs"
	depends on BR2_PACKAGE_HOST_RUSTC_TARGET_ARCH_SUPPORTS
	select BR2_PACKAGE_HOST_RUSTC
	help
	  knock-rs is a port-knocking implementation in Rust.

	  https://github.com/darktohka/knock-rs
```

## package/mainlinebuildkit/Config.in
```kconfig
config BR2_PACKAGE_MAINLINEBUILDKIT
	bool "mainlinebuildkit"
	depends on BR2_PACKAGE_HOST_GO_TARGET_ARCH_SUPPORTS
	depends on BR2_PACKAGE_HOST_GO_TARGET_CGO_LINKING_SUPPORTS
	depends on BR2_TOOLCHAIN_HAS_THREADS
	depends on !BR2_TOOLCHAIN_USES_UCLIBC
	depends on BR2_USE_MMU
	help
	  BuildKit is a toolkit for converting source code to build
	  artifacts in an efficient, expressive and repeatable manner.

	  https://github.com/moby/buildkit

comment "moby-buildkit needs a glibc or musl toolchain w/ threads"
	depends on BR2_PACKAGE_HOST_GO_TARGET_ARCH_SUPPORTS
	depends on BR2_PACKAGE_HOST_GO_TARGET_CGO_LINKING_SUPPORTS
	depends on !BR2_TOOLCHAIN_HAS_THREADS || BR2_TOOLCHAIN_USES_UCLIBC
	depends on BR2_USE_MMU
```

## package/nghttp3/Config.in
```kconfig
config BR2_PACKAGE_NGHTTP3
	bool "nghttp3"
	help
	  nghttp3 is an implementation of HTTP/3.
```

## package/ngtcp2/Config.in
```kconfig
config BR2_PACKAGE_NGTCP2
	bool "ngtcp2"
	help
	  ngtcp2 is an implementation of QUIC.
```

## package/opendoas/Config.in
```kconfig
config BR2_PACKAGE_OPENDOAS
	bool "opendoas"
	help
	  Sudo replacement

	  https://github.com/darktohka/opendoas
```

## package/ugrep/Config.in
```kconfig
config BR2_PACKAGE_UGREP
	bool "ugrep"
	depends on BR2_PACKAGE_PCRE2
	depends on BR2_PACKAGE_ZSTD
	depends on BR2_PACKAGE_ZLIB_NG
	depends on BR2_PACKAGE_XZ
	help
	  Grep replacement

	  https://github.com/Genivia/ugrep
```

## package/zebrafish-config/Config.in
```kconfig
config BR2_PACKAGE_ZEBRAFISH_CONFIG
	bool "zebrafish-config"
	depends on BR2_PACKAGE_HOST_RUSTC_TARGET_ARCH_SUPPORTS
	select BR2_PACKAGE_HOST_RUSTC
	help
	  Configuration management tool for Zebrafish.

	  Parses /etc/zebrafish.toml and the EFI-resident zebrafish.toml,
	  exposes their contents via ergonomic subcommands
	  (get/set/list/add/remove/edit) and is used by every
	  /etc/init.d/S* script and helper under /lib/zebrafish/ to
	  replace the legacy kernel-command-line interface.
```

## package/zebrafish-dns/Config.in
```kconfig
config BR2_PACKAGE_ZEBRAFISH_DNS
	bool "zebrafish-dns"
	depends on BR2_PACKAGE_HOST_RUSTC_TARGET_ARCH_SUPPORTS
	select BR2_PACKAGE_HOST_RUSTC
	help
	  DNS over HTTPS proxy server for Zebrafish.

	  Listens on localhost port 53 for standard DNS queries and
	  proxies them to a configurable DoH upstream (Cloudflare,
	  Google, Quad9, or custom). Includes in-process caching
	  and an NSS module for system resolver integration.

	  Built with Rust using the hickory-dns library.
```

## package/zfsexporter/Config.in
```kconfig
config BR2_PACKAGE_ZFSEXPORTER
	bool "zfsexporter"
	help
	  Prometheus exporter for ZFS (pools, filesystems,
	  snapshots and volumes).

	  https://github.com/pdf/zfs_exporter/
```

## package/zrepl/Config.in
```kconfig
config BR2_PACKAGE_ZREPL
	bool "zrepl"
	help
	  ZFS Replication

	  https://github.com/zrepl/zrepl
```
