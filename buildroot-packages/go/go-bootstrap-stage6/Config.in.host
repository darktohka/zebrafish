## buildroot-packages/go/go-bootstrap-stage6/Config.in.host
```kconfig
config BR2_PACKAGE_HOST_GO_BOOTSTRAP_STAGE6_ARCH_SUPPORTS
	bool
	default y
	depends on BR2_PACKAGE_HOST_GO_BOOTSTRAP_STAGE5_ARCH_SUPPORTS
```
